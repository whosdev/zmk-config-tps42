## config/boards/shields/tps42/Kconfig.defconfig
```kconfig
# Copyright (c) 2020 The ZMK Contributors
# SPDX-License-Identifier: MIT

if SHIELD_TPS42_LEFT

config ZMK_KEYBOARD_NAME
	default "TPS42"

config ZMK_SPLIT_ROLE_CENTRAL
	default y

endif

if SHIELD_TPS42_LEFT || SHIELD_TPS42_RIGHT

config ZMK_SPLIT
	default y

endif
```

## config/west.yml
```yaml
manifest:
  remotes:
    - name: zmkofficial
      url-base: https://github.com/zmkfirmware
    - name: rbitanga
      url-base: https://github.com/rbitanga
  projects:
    - name: zmk
      remote: zmkofficial
      revision: main
      import: app/west.yml
  self:
    path: config
```
